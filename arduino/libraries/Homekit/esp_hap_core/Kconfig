## arduino/libraries/Homekit/esp_hap_core/Kconfig
```kconfig
menu "HomeKit"

    config HAP_MFI_ENABLE
        bool "Enable MFi"
        default n
        help
            If you have the MFi variant of the SDK, set this to true to use features like
            HW authentication, software token authentication and WAC.

    config HAP_SESSION_KEEP_ALIVE_ENABLE
        bool "Enable Keep Alive on sessions"
        default n
        depends on !HAP_MFI_ENABLE
        help
            Enable Keep Alive on Controller Sessions so that stale connections do not stay
            open indefinitely. Note that the HomeKit Specs do not allow this and so, this
            should be enabled at your own risk. Even without this option, the HomeKit core
            will close stale session using the HTTP Server's Least Recently Used (LRU) purge
            logic.

    config EXAMPLE_USE_HARDCODED_SETUP_CODE
        bool "Use hard-coded setup code"
        default y
        help
            HomeKit does not recommend having the setup code programmed in the accessory as is.
            Instead, it expects setup info (salt-verifier pair) generated for the given setup code.
            Use this option only for testing purposes. For production, the setup info should be
            used.

    config EXAMPLE_SETUP_CODE
        string "HomeKit Setup Code"
        default "123-21-123"
        depends on EXAMPLE_USE_HARDCODED_SETUP_CODE
        help
            Setup code to be used for HomeKot pairing, if hard-coded setup code is enabled.

    config EXAMPLE_SETUP_ID
        string "HomeKit Setup Id"
        default "CY1U"
        depends on EXAMPLE_USE_HARDCODED_SETUP_CODE
        help
            Setup id to be used for HomeKot pairing, if hard-coded setup code is enabled.

endmenu
```
